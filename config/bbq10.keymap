#include <behaviors.dtsi>
#include <dt-bindings/zmk/keys.h>
#include <dt-bindings/zmk/bt.h>
#include <dt-bindings/zmk/outputs.h>
#include <dt-bindings/zmk/mouse.h>
#include <dt-bindings/zmk/backlight.h>
#include <dt-bindings/zmk/ext_power.h>

#include "zmk-helpers/helper.h"

// LAYERS
#define BASE 0
#define WORD 1
#define ARROW 2
#define NUM 3
#define FUNC 4
#define GAME 5
#define SYS 6
#define NAV 7

#define __ &trans
#define XX &none
#define LMEH LS(LA(LCTL))
#define RMEH RS(RA(RCTL))
#define LHYP LG(LS(LA(LCTL)))

#define KP_L &hm LA(LEFT) LEFT
#define KP_D &kp DOWN
#define KP_U &kp UP
#define KP_R &hm LA(RIGHT) RIGHT
#define SEL_L &kp LS(LEFT)
#define SEL_D &kp LS(DOWN)
#define SEL_U &kp LS(UP)
#define SEL_R &kp LS(RIGHT)

#define BRDN &kp C_BRI_DN
#define BRUP &kp C_BRI_UP
#define VOLDN &kp C_VOL_DN
#define VOLUP &kp C_VOL_UP
#define BT(X) &bt BT_SEL X

#define NSPC &kp LG(PG_DN)
#define PSPC &kp LG(PG_UP)
#define MV_NSPC &kp LS(LG(PG_DN))
#define MV_PSPC &kp LS(LG(PG_UP))
#define BACK LG(LBKT)
#define FORWARD LG(RBKT)
#define PTAB LC(LS(TAB))
#define NTAB LC(TAB)

#define HLP(X) &hm LCTRL X
#define HLR(X) &hm LALT  X
#define HLM(X) &hm LGUI  X
#define HLI(X) &hm LSHFT X

#define HRP(X) &hm RCTRL X
#define HRR(X) &hm RALT  X
#define HRM(X) &hm RGUI  X
#define HRI(X) &hm RSHFT X

#define SH(X) &sh LG(X) X
#define TTY(X) &sh LA(LC(X)) X
#define WR1(X) &wrap1 X
#define KPWR(X) &kp_wrap X X
#define DBDB(X) &dble_dble LG(LS(LA(LC(X)))) LS(LA(LC(X))) 
#define HYME(X) &meh_hyp X X 
#define DBLE(X) &kp_dble X X
#define PAR &wrap2 LPAR RPAR
#define BRC &wrap2 LBRC RBRC
#define BKT &wrap2 LBKT RBKT
#define ABKT &wrap2 LT GT

&sk {
    release-after-ms = <1000>;
    quick-release;
};

// HOLD-TAP
ZMK_HOLD_TAP(hm,
     flavor = "tap-preferred";
     tapping-term-ms = <200>;
     quick-tap-ms = <180>;
     require-prior-idle-ms = <125>;
     bindings = <&kp>, <&kp>;
)
ZMK_HOLD_TAP(sh,
     flavor = "tap-preferred";
     tapping-term-ms = <250>;
     quick-tap-ms = <180>;
     require-prior-idle-ms = <125>;
     bindings = <&kp>, <&kp>;
)
ZMK_HOLD_TAP(ltt,
     flavor = "tap-preferred";
     tapping-term-ms = <200>;
     quick-tap-ms = <180>;
     bindings = <&mo>, <&kp>;
)
ZMK_HOLD_TAP(mosk,
     flavor = "tap-preferred";
     tapping-term-ms = <200>;
     quick-tap-ms = <180>;
     bindings = <&mo>, <&sk>;
)
ZMK_HOLD_TAP(mosl,
     flavor = "tap-preferred";
     tapping-term-ms = <200>;
     quick-tap-ms = <180>;
     bindings = <&mo>, <&sl>;
)
ZMK_HOLD_TAP(kpsk,
     flavor = "tap-preferred";
     tapping-term-ms = <200>;
     quick-tap-ms = <180>;
     bindings = <&kp>, <&sk>;
)
ZMK_HOLD_TAP(skkp,
     flavor = "tap-preferred";
     tapping-term-ms = <200>;
     quick-tap-ms = <180>;
     bindings = <&sk>, <&kp>;
)
ZMK_HOLD_TAP(kpsl,
     flavor = "tap-preferred";
     tapping-term-ms = <200>;
     quick-tap-ms = <180>;
     bindings = <&kp>, <&sl>;
)

// CAPS-WORD
ZMK_CAPS_WORD(cap_word,
     mods = <MOD_LSFT>;
     continue-list = <UNDERSCORE MINUS FSLH BKSP DEL LEFT RIGHT UP DOWN>;
)
ZMK_AUTO_LAYER(number_word,
     continue-list = <SEMI MINUS PLUS EQUAL COLON UNDERSCORE TILDE FSLH COMMA DOT BKSP DEL LEFT RIGHT UP DOWN>;
     ignore-numbers;
)
ZMK_AUTO_LAYER(func_word,
     continue-list = <LPAR RPAR LBKT RBKT LBRC RBRC LT GT SPACE EQUAL EXCL DLLR COLON END MINUS LEFT>;
)
ZMK_AUTO_LAYER(arrow,
     continue-list = <LEFT RIGHT UP DOWN>;
     ignore-modifiers;
)

ZMK_TAP_DANCE(num_dance, 
    bindings = <&mosl FUNC NUM>, <&number_word NUM>;
    tapping-term-ms = <200>;
)

ZMK_TAP_DANCE(cap_dance, 
    bindings = <&kpsk ESC LSFT>, <&cap_word>;
    tapping-term-ms = <200>;
)
ZMK_TAP_DANCE(quote_dance, 
    bindings = <&quote>, <&kp RIGHT>;
    tapping-term-ms = <200>;
)

ZMK_TAP_DANCE(space, 
    bindings = <&ltt NAV SPACE>, <&kp LG(SPACE)>;
    tapping-term-ms = <200>;
)

ZMK_MACRO(arrow_left,
     wait-ms = <0>;
     tap-ms = <5>;
     bindings = <&macro_press &kp LEFT>,
	<&macro_pause_for_release>,
	<&macro_release &kp LEFT>,
	<&macro_tap &arrow ARROW>;
)
ZMK_MACRO(arrow_right,
     wait-ms = <0>;
     tap-ms = <5>;
     bindings = <&macro_press &kp RIGHT>,
	<&macro_pause_for_release>,
	<&macro_release &kp RIGHT>,
	<&macro_tap &arrow ARROW>;
)
ZMK_MACRO(arrow_up,
     wait-ms = <0>;
     tap-ms = <5>;
     bindings = <&macro_press &kp UP>,
	<&macro_pause_for_release>,
	<&macro_release &kp UP>,
	<&macro_tap &arrow ARROW>;
)
ZMK_MACRO(arrow_down,
     wait-ms = <0>;
     tap-ms = <5>;
     bindings = <&macro_press &kp DOWN>,
	<&macro_pause_for_release>,
	<&macro_release &kp DOWN>,
	<&macro_tap &arrow ARROW>;
)
ZMK_MACRO(arrow_ul,
     wait-ms = <0>;
     tap-ms = <5>;
     bindings = <&macro_press &kp LEFT>,
	<&macro_press &kp UP>,
	<&macro_pause_for_release>,
	<&macro_release &kp UP>,
	<&macro_release &kp LEFT>;
)
ZMK_MACRO(arrow_ur,
     wait-ms = <0>;
     tap-ms = <5>;
     bindings = <&macro_press &kp RIGHT>,
	<&macro_press &kp UP>,
	<&macro_pause_for_release>,
	<&macro_release &kp UP>,
	<&macro_release &kp RIGHT>;
)
ZMK_MACRO(arrow_dl,
     wait-ms = <0>;
     tap-ms = <5>;
     bindings = <&macro_press &kp LEFT>,
	<&macro_press &kp DOWN>,
	<&macro_pause_for_release>,
	<&macro_release &kp DOWN>,
	<&macro_release &kp LEFT>;
)
ZMK_MACRO(arrow_dr,
     wait-ms = <0>;
     tap-ms = <5>;
     bindings = <&macro_press &kp RIGHT>,
	<&macro_press &kp DOWN>,
	<&macro_pause_for_release>,
	<&macro_release &kp DOWN>,
	<&macro_release &kp RIGHT>;
)

// MOD-MORPH
ZMK_MOD_MORPH(bksp_tab,
     bindings = <&hm ESC BKSP>, <&kp TAB>;
     mods = <(MOD_LSFT|MOD_LCTL|MOD_LALT|MOD_LGUI)>;
     keep-mods = <(MOD_LCTL|MOD_LALT|MOD_LGUI)>;
)
ZMK_MOD_MORPH(num_stab,
     bindings = <&sl NUM>, <&kp LS(TAB)>;
     mods = <(MOD_LSFT|MOD_LCTL|MOD_LALT|MOD_LGUI)>;
     keep-mods = <(MOD_LCTL|MOD_LALT|MOD_LGUI)>;
)
ZMK_MOD_MORPH(meh_spc_tab,
     bindings = <&hm LMEH SPACE>, <&kp TAB>;
     mods = <(MOD_LSFT)>; // left hand only
)
ZMK_MOD_MORPH(dot_excl,
     bindings = <SH(DOT)>, <DBLE(EXCL)>;
     mods = <(MOD_LSFT|MOD_RSFT)>;
)
ZMK_MOD_MORPH(comma_semicolon,
     bindings = <SH(COMMA)>, <SH(SEMI)>;
     mods = <(MOD_LSFT|MOD_RSFT)>;
)

// MACROS
ZMK_MACRO(begin_cap_word,
     wait-ms = <0>;
     bindings = <&to WORD &cap_word>;
)
ZMK_MACRO(end_cap_word,
     wait-ms = <0>;
     bindings = <&kp K_CANCEL &to BASE>;
)
ZMK_MACRO_ONE_PARAM(iosmeh,
     wait-ms = <15>;
     tap-ms = <30>;
     bindings = <&macro_press &kp LSFT &kp LCTL &kp LALT>
	        , <&macro_param_1to1>
                , <&macro_tap &kp MACRO_PLACEHOLDER>
	        , <&macro_param_1to1>
                , <&macro_tap &kp MACRO_PLACEHOLDER>
                , <&macro_release &kp LSFT &kp LCTL &kp LALT>;
)
ZMK_MACRO_ONE_PARAM(ioshyp,
     wait-ms = <15>;
     tap-ms = <30>;
     bindings = <&macro_press &kp LGUI &kp LSFT &kp LCTL &kp LALT>
	        , <&macro_param_1to1>
                , <&macro_tap &kp MACRO_PLACEHOLDER>
	        , <&macro_param_1to1>
                , <&macro_tap &kp MACRO_PLACEHOLDER>
                , <&macro_release &kp LGUI &kp LSFT &kp LCTL &kp LALT>;
)
ZMK_MACRO_ONE_PARAM(dble,
     wait-ms = <10>;
     bindings = <&macro_param_1to1>, <&kp MACRO_PLACEHOLDER>, <&macro_param_1to1>, <&kp MACRO_PLACEHOLDER>;
)
ZMK_MACRO_ONE_PARAM(wrap1,
     wait-ms = <10>;
     bindings = <&macro_param_1to1>, <&kp MACRO_PLACEHOLDER>, <&macro_param_1to1>, <&kp MACRO_PLACEHOLDER &kp LEFT>;
)
ZMK_MACRO_TWO_PARAM(wrap2,
     wait-ms = <10>;
     bindings = <&macro_param_1to1>, <&kp MACRO_PLACEHOLDER>, <&macro_param_2to1>, <&kp MACRO_PLACEHOLDER &kp LEFT>;
)
ZMK_HOLD_TAP(kp_wrap,
     flavor = "tap-preferred";
     tapping-term-ms = <200>;
     quick-tap-ms = <180>;
     bindings = <&wrap1>, <&kp>;
)
ZMK_HOLD_TAP(kp_dble,
     flavor = "tap-preferred";
     tapping-term-ms = <200>;
     quick-tap-ms = <180>;
     bindings = <&dble>, <&kp>;
)
ZMK_HOLD_TAP(meh_hyp,
     flavor = "tap-preferred";
     tapping-term-ms = <200>;
     quick-tap-ms = <180>;
     bindings = <&ioshyp>, <&iosmeh>;
)

ZMK_MACRO(arrow1,
     wait-ms = <10>;
     bindings = <&kp SPACE &kp EQUAL &kp GT &kp SPACE>;
)
ZMK_MACRO(arrow2,
     wait-ms = <10>;
     bindings = <&kp SPACE &kp MINUS &kp GT &kp SPACE>;
)
ZMK_MACRO(endsemi,
     wait-ms = <10>;
     bindings = <&kp END &kp SEMI>;
)
ZMK_MACRO(shell_arg,
     wait-ms = <10>;
     bindings = <&kp EXCL &kp EXCL &kp COLON &kp DLLR>;
)
ZMK_MOD_MORPH(quote_alt,
     bindings = <KPWR(SQT)>, <KPWR(GRAVE)>;
     mods = <(MOD_LALT|MOD_RALT)>;
)
ZMK_MOD_MORPH(quote,
     bindings = <&quote_alt>, <KPWR(DQT)>;
     mods = <(MOD_LSFT|MOD_RSFT)>;
)

//         --------------------------------------------------------------------------------------------------------------------------         
//         |    Shoulder Key1    |                                                                             |    Shoulder Key2    |     
// |         Call key      |      Blackberry Key        |    Trackpad    |             Back Key                |             Endcall Key          |
// |     Q      |     W    |     E    |     R    |      T      |       Y        |       U        |        I        |       O      |      P        |     
// |     A      |     S    |     D    |     F    |      G      |       H        |       J        |        K        |       L      |      ←        |  
// |     alt    |     Z    |     X    |     C    |      V      |       B        |       N        |        M        |       $      |    Enter      |   
//        |         aA     |         0           |           SPACE              |         SYM         |        aA          |       
//        -----------------------------------------------------------------------------------------------------------------
//
// q w f p b j l u y '
// a r s t g m n e i o
// z x c d v k h , . /
// ls 0 spc sym rs
// 
// row1
// _ w _ _ b j _ u _ '
// a r s t g m n e i o
// z x c d v k h , . /
// ls 0 spc sym rs
//
// row2
// q _ f p b j l u y '
// a _ s t _ _ n e _ o
// z x c d v k h , . /
// ls 0 spc sym rs
// 
// row3
// q w f p _ _ l _ y '
// a r _ t g m n e i o
// z x c d v k h , . /
// ls 0 spc _ rs
//
// row4
// q w f p b j l u y _
// _ r s t g m n e i _
// z x c d v k h , . _
// ls 0 spc sym _
//
// row5
// q w f p b j l u y '
// a r s t g m n e i o
// _ x _ d _ _ h , _ /
// ls 0 spc sym rs
//
// row6
// q w f p b j l u y '
// a r s t g m n e i o
// z _ c _ v h _ _ . /
// ls 0 _ sym rs
//
// row7
// q w f p b j l u y '
// a r s _ g m _ _ i o
// z x c d v k h , . /
// _ _ spc sym rs
//
// LAYERS
ZMK_LAYER(home,
                 &bootloader                            &bt BT_CLR
                 &kp CLCK     &kp LGUI        &mkp LCLK      &kp ESC    &kp TAB
		 SH(Q) SH(W) SH(F) SH(P) SH(B)         SH(J) SH(L) SH(U) SH(Y) &quote_dance
		 SH(A) SH(R) SH(S) SH(T) SH(G)         SH(M) SH(N) SH(E) SH(I) SH(O)
		 SH(Z) SH(X) SH(C) SH(D) SH(V)         SH(K) SH(H)  &comma_semicolon &dot_excl &hm LG(SPACE) FSLH
	  &cap_dance &num_dance &ltt NAV SPACE         &skkp LCTL RET &hm LA(BKSP) BKSP
)

ZMK_LAYER(caps,
				__                     __
				__    __      __       __    __
                                __ __ __ __ __         __ __ __ __ __
                                __ __ __ __ __         __ __ __ __ __
                                __ __ __ __ __         __ __ __ __ __
			   &end_cap_word __ __         __ __
)

ZMK_LAYER(arrow,
				__                     __
				  __    __      __       __    __
			   HLM(Q) __ __ __ __         __ __ __ __ __
                               __ __ __ __ __         __ KP_L KP_D KP_U KP_R
			   HLI(Z) __ __ __ __         __ __ __ __ __
				     __ __ __         __ __
)

ZMK_LAYER(num,
				__                     __
				__    __      __       __    __
    SH(HOME) SH(AT) SH(HASH) SH(DLLR) SH(PRCNT)         SH(CARET) DBLE(AMPS) SH(STAR) DBLE(PIPE) SH(END)
	     SH(N1) SH(N2) SH(N3) SH(N4) SH(N5)         SH(N6) SH(N7) SH(N8) SH(N9) SH(N0)
SH(TILDE) DBLE(MINUS) DBLE(PLUS) DBLE(EQUAL) DBLE(COLON)        DBLE(BSLH) DBLE(UNDER) __ __ __
                                 __ &tog NUM __         __ __
)

ZMK_LAYER(func,
				__                     __
				__    __      __       __    __
				__ __ __ __ __          __   SH(LT)   SH(GT)   SH(LBKT) SH(RBKT) 
				__ __ __ XX __          __   XX       XX       SH(LBRC) SH(RBRC) 
	&shell_arg &arrow2 &arrow1 &endsemi __          __   __       __       SH(LPAR) SH(RPAR)
				 &to BASE __ __         __ __
)

ZMK_LAYER(game,
				__                     __
				__    __      __       __    __
		 &arrow_ul &kp UP &arrow_ur XX XX         XX &kp R XX XX XX
		   &kp LEFT &kp L &kp RIGHT XX XX         XX &kp A &kp B XX XX
	       &arrow_dl &kp DOWN &arrow_dr XX XX         XX &kp X &kp Y XX XX
				 &to BASE __ __         &kp RET &kp M
)

ZMK_LAYER(sys,
				__                     __
				__    __      __       __    __
			  __ __ __ __ &bootloader        BT(4) BT(3) BT(2) BT(1) BT(0)
				  __ __ __ XX __         __    XX         XX              VOLUP BRUP
			  &bt BT_CLR __ __ __ __         __  &out OUT_BLE &out OUT_USB    VOLDN BRDN
				  &to BASE __ __         __  __
)

ZMK_LAYER(nav,
				__                     __
				__    __      __       __    __

		 HYME(Q) HYME(W) HYME(F) HYME(P) HYME(B)         HYME(J) &kp BACK    &kp PTAB    &kp NTAB    &kp FORWARD
		 HYME(A) HYME(R) HYME(S) HYME(T) HYME(G)         HYME(M) &arrow_left &arrow_down &arrow_up   &arrow_right
		 HYME(Z) XX      HYME(C) XX      HYME(V)         HYME(K) XX          XX          &kp LS(TAB) &kp TAB
				    &tog GAME &sl SYS __        __ &hm LA(DEL) DEL
)
