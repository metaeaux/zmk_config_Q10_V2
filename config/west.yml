## config/west.yml
```yaml
manifest:
  remotes:
    - name: zmkfirmware
      url-base: https://github.com/zmkfirmware
    - name: krikun98
      url-base: https://github.com/krikun98
    - name: benvallack
      url-base: https://github.com/benvallack
    - name: metaeaux
      url-base: https://github.com/metaeaux
    - name: ftc
      url-base: https://github.com/ftc
    - name: urob
      url-base: https://github.com/urob
    - name: badjeff
      url-base: https://github.com/badjeff
    - name: dhruvinsh
      url-base: https://github.com/dhruvinsh
    - name: ZitaoTech
      url-base: https://github.com/ZitaoTech
  projects:
    - name: zmk
      remote: ZitaoTech
      revision: bbkeyboard_tp
      import: app/west.yml
    # - name: zmk
    #   remote: urob
    #   revision: going-modular
    #   import: app/west.yml
    - name: zmk-helpers
      remote: urob
      revision: main
    - name: zmk-auto-layer
      remote: urob
      revision: main
  self:
    path: config
```
